## audio_test/sdkconfig.defaults
```kconfig
CONFIG_BLINK_LED_GPIO=y
CONFIG_BLINK_GPIO=8

# Flash配置
CONFIG_ESPTOOLPY_FLASHMODE_QIO=y
CONFIG_ESPTOOLPY_FLASHFREQ_80M=y
CONFIG_ESPTOOLPY_FLASHSIZE_4MB=y

# 内存配置
CONFIG_ESP32S3_DATA_CACHE_64KB=y
CONFIG_ESP32S3_INSTRUCTION_CACHE_32KB=y

# 日志配置
CONFIG_LOG_DEFAULT_LEVEL_INFO=y
CONFIG_LOG_MAXIMUM_LEVEL_VERBOSE=y

# FreeRTOS配置
CONFIG_FREERTOS_HZ=1000
CONFIG_FREERTOS_UNICORE=n

# I2S配置
CONFIG_ESP32S3_I2S_NUM=2

# 内存优化
CONFIG_ESP_MAIN_TASK_STACK_SIZE=8192
CONFIG_ESP_SYSTEM_EVENT_TASK_STACK_SIZE=4096
```

## esp32_http_mp3/sdkconfig.defaults
```kconfig
CONFIG_BLINK_LED_GPIO=y
CONFIG_BLINK_GPIO=8

# Enable I2S driver
CONFIG_DRIVER_I2S_ENABLE=y

# Enable I2C driver
CONFIG_DRIVER_I2C_ENABLE=y

# Set log level
CONFIG_LOG_DEFAULT_LEVEL_INFO=y

# FreeRTOS configurations
CONFIG_FREERTOS_HZ=1000

# 在esp32_audio/sdkconfig中添加以下配置

#
# WiFi Configuration
#
CONFIG_ESP32_WIFI_ENABLED=y
CONFIG_ESP32_WIFI_SW_COEXIST_ENABLE=y
CONFIG_ESP32_WIFI_STATIC_RX_BUFFER_NUM=10
CONFIG_ESP32_WIFI_DYNAMIC_RX_BUFFER_NUM=32
CONFIG_ESP32_WIFI_DYNAMIC_TX_BUFFER_NUM=32
CONFIG_ESP32_WIFI_CSI_ENABLED=y

#
# SPIFFS Configuration  
#
CONFIG_SPIFFS_MAX_PARTITIONS=3
CONFIG_SPIFFS_CACHE=y
CONFIG_SPIFFS_CACHE_WR=y
CONFIG_SPIFFS_CACHE_STATS=y
CONFIG_SPIFFS_PAGE_CHECK=y
CONFIG_SPIFFS_GC_MAX_RUNS=10
CONFIG_SPIFFS_GC_STATS=y
CONFIG_SPIFFS_PAGE_SIZE=256
CONFIG_SPIFFS_OBJ_NAME_LEN=32
CONFIG_SPIFFS_USE_MAGIC=y
CONFIG_SPIFFS_USE_MAGIC_LENGTH=y
CONFIG_SPIFFS_META_LENGTH=4
CONFIG_SPIFFS_USE_MTIME=y

#
# HTTP Client Configuration
#
CONFIG_ESP_HTTP_CLIENT_ENABLE_HTTPS=y
CONFIG_ESP_HTTP_CLIENT_ENABLE_BASIC_AUTH=y
CONFIG_ESP_HTTP_CLIENT_ENABLE_DIGEST_AUTH=y

#
# FreeRTOS Configuration
#
CONFIG_FREERTOS_HZ=1000
CONFIG_FREERTOS_TASK_FUNCTION_WRAPPER=y
CONFIG_FREERTOS_CHECK_STACKOVERFLOW_CANARY=y

#
# Component Configuration
#
CONFIG_ESP_NETIF_IP_LOST_TIMER_INTERVAL=120
CONFIG_ESP_NETIF_TCPIP_LWIP=y

#
# LWIP Configuration  
#
CONFIG_LWIP_IP_FRAG=y
CONFIG_LWIP_IP_REASSEMBLY=y
CONFIG_LWIP_STATS=y
CONFIG_LWIP_ETHARP_TRUST_IP_MAC=y
CONFIG_LWIP_ESP_GRATUITOUS_ARP=y
CONFIG_LWIP_GARP_TMR_INTERVAL=60

#
# mbedTLS Configuration
#
CONFIG_MBEDTLS_CERTIFICATE_BUNDLE=y
CONFIG_MBEDTLS_CERTIFICATE_BUNDLE_DEFAULT_FULL=y

#
# Partition Table Configuration
#
CONFIG_PARTITION_TABLE_CUSTOM=y
CONFIG_PARTITION_TABLE_CUSTOM_FILENAME="partitions.csv"
CONFIG_PARTITION_TABLE_FILENAME="partitions.csv"
```

## esp32_http_pcm/sdkconfig.defaults
```kconfig
CONFIG_BLINK_LED_GPIO=y
CONFIG_BLINK_GPIO=8

# Enable I2S driver
CONFIG_DRIVER_I2S_ENABLE=y

# Enable I2C driver
CONFIG_DRIVER_I2C_ENABLE=y

# Set log level
CONFIG_LOG_DEFAULT_LEVEL_INFO=y

# FreeRTOS configurations
CONFIG_FREERTOS_HZ=1000
```

## esp32_http_pcm_v3/sdkconfig.defaults
```kconfig
# ESP32-S3 specific
CONFIG_IDF_TARGET="esp32s3"

# Flash Configuration for ESP32-S3-WROOM-1-N16R8 (16MB Flash)
CONFIG_ESPTOOLPY_FLASHSIZE_16MB=y
CONFIG_ESPTOOLPY_FLASHSIZE="16MB"
CONFIG_ESPTOOLPY_FLASHSIZE_DETECT=y

# PSRAM Configuration for ESP32-S3-WROOM-1-N16R8
CONFIG_ESP32S3_SPIRAM_SUPPORT=y
CONFIG_SPIRAM=y
CONFIG_SPIRAM_MODE_OCT=y
CONFIG_SPIRAM_TYPE_ESPPSRAM64=y
CONFIG_SPIRAM_SIZE=8388608
CONFIG_SPIRAM_SPEED_80M=y
CONFIG_SPIRAM_BOOT_INIT=y
CONFIG_SPIRAM_USE_MALLOC=y
CONFIG_SPIRAM_MEMTEST=y
CONFIG_SPIRAM_MALLOC_ALWAYSINTERNAL=16384
CONFIG_SPIRAM_MALLOC_RESERVE_INTERNAL=32768

# Enable PSRAM for heap allocation
CONFIG_SPIRAM_ALLOW_BSS_SEG_EXTERNAL_MEMORY=y
CONFIG_SPIRAM_ALLOW_NOINIT_SEG_EXTERNAL_MEMORY=y

# Memory allocation strategy
CONFIG_SPIRAM_TRY_ALLOCATE_WIFI_LWIP=y
CONFIG_SPIRAM_CACHE_LIBGCC_FUNCTIONS=y

# Partition Table Configuration
CONFIG_PARTITION_TABLE_CUSTOM=y
CONFIG_PARTITION_TABLE_CUSTOM_FILENAME="partitions.csv"
CONFIG_PARTITION_TABLE_OFFSET=0x8000

# WiFi Configuration
CONFIG_ESP32_WIFI_STATIC_RX_BUFFER_NUM=10
CONFIG_ESP32_WIFI_DYNAMIC_RX_BUFFER_NUM=32
CONFIG_ESP32_WIFI_STATIC_TX_BUFFER=n
CONFIG_ESP32_WIFI_DYNAMIC_TX_BUFFER=y
CONFIG_ESP32_WIFI_TX_BUFFER_TYPE=1
CONFIG_ESP32_WIFI_DYNAMIC_TX_BUFFER_NUM=32
CONFIG_ESP32_WIFI_AMPDU_TX_ENABLED=y
CONFIG_ESP32_WIFI_TX_BA_WIN=6
CONFIG_ESP32_WIFI_AMPDU_RX_ENABLED=y
CONFIG_ESP32_WIFI_RX_BA_WIN=6
CONFIG_ESP32_WIFI_NVS_ENABLED=y
CONFIG_ESP32_WIFI_TASK_PINNED_TO_CORE_0=y
CONFIG_ESP32_WIFI_SOFTAP_BEACON_MAX_LEN=752
CONFIG_ESP32_WIFI_MGMT_SBUF_NUM=32
CONFIG_ESP32_WIFI_IRAM_OPT=y
CONFIG_ESP32_WIFI_RX_IRAM_OPT=y
CONFIG_ESP32_WIFI_ENABLE_WPA3_SAE=y
CONFIG_ESP32_WIFI_ENABLE_WPA3_OWE_STA=y

# HTTP Client Configuration
CONFIG_ESP_HTTP_CLIENT_ENABLE_HTTPS=n
CONFIG_ESP_HTTP_CLIENT_BUFFER_SIZE=4096
CONFIG_ESP_HTTP_CLIENT_MAX_RESP_BUFFER_SIZE=2048
CONFIG_HTTPD_MAX_REQ_HDR_LEN=1024

# LWIP Configuration
CONFIG_LWIP_MAX_SOCKETS=10
CONFIG_LWIP_SO_REUSE=y
CONFIG_LWIP_SO_REUSE_RXTOALL=y
CONFIG_LWIP_IP_REASSEMBLY=y
CONFIG_LWIP_TCP_MAXRTX=12
CONFIG_LWIP_TCP_SYNMAXRTX=12

# TCP/IP Stack
CONFIG_LWIP_TCP_MSS=1440
CONFIG_LWIP_TCP_SND_BUF_DEFAULT=8192
CONFIG_LWIP_TCP_WND_DEFAULT=8192
CONFIG_LWIP_TCP_RECVMBOX_SIZE=6
CONFIG_TCP_MAXRTX=12
CONFIG_TCP_SYNMAXRTX=12
CONFIG_TCP_MSS=1440
CONFIG_TCP_SND_BUF_DEFAULT=8192
CONFIG_TCP_WND_DEFAULT=8192
CONFIG_TCP_RECVMBOX_SIZE=6

# Increase main task stack size
CONFIG_ESP_MAIN_TASK_STACK_SIZE=8192

# Enable JSON library
CONFIG_JSMN=y

# FreeRTOS
CONFIG_FREERTOS_HZ=1000

# Enable I2S driver
CONFIG_DRIVER_I2S_ENABLE=y

# Enable I2C driver
CONFIG_DRIVER_I2C_ENABLE=y

# Set log level
CONFIG_LOG_DEFAULT_LEVEL_INFO=y

# Enable memory debugging (optional, can be disabled in production)
CONFIG_HEAP_POISONING_LIGHT=y
CONFIG_HEAP_TRACING_OFF=y
```

## esp32_http_pcm_v4/sdkconfig.defaults
```kconfig
# ESP32S3 specific
CONFIG_IDF_TARGET="esp32s3"

# Flash Configuration - 针对ESP32-S3-WROOM-1-N16R8
CONFIG_ESPTOOLPY_FLASHMODE_QIO=y
CONFIG_ESPTOOLPY_FLASHFREQ_80M=y
CONFIG_ESPTOOLPY_FLASHSIZE_16MB=y
CONFIG_ESPTOOLPY_FLASHSIZE="16MB"

# PSRAM Configuration - 新增PSRAM支持
CONFIG_SPIRAM=y
CONFIG_SPIRAM_MODE_OCT=y
CONFIG_SPIRAM_TYPE_AUTO=y
CONFIG_SPIRAM_SPEED_80M=y
CONFIG_SPIRAM_MALLOC_ALWAYSINTERNAL=0
CONFIG_SPIRAM_MALLOC_RESERVE_INTERNAL=32768
CONFIG_SPIRAM_USE_MALLOC=y
CONFIG_SPIRAM_USE_CAPS_ALLOC=y
CONFIG_SPIRAM_USE_MEMMAP=y
CONFIG_SPIRAM_MEMTEST=y
CONFIG_SPIRAM_ALLOW_BSS_SEG_EXTERNAL_MEMORY=y
CONFIG_SPIRAM_ALLOW_NOINIT_SEG_EXTERNAL_MEMORY=y
CONFIG_SPIRAM_ALLOW_STACK_EXTERNAL_MEMORY=y

# Memory Management for PSRAM
CONFIG_SPIRAM_TRY_ALLOCATE_WIFI_LWIP=y
CONFIG_SPIRAM_CACHE_WORKAROUND=y

# Partition Table Configuration
CONFIG_PARTITION_TABLE_CUSTOM=y
CONFIG_PARTITION_TABLE_CUSTOM_FILENAME="partitions.csv"

# WiFi Configuration - 保持不变
CONFIG_ESP32_WIFI_STATIC_RX_BUFFER_NUM=10
CONFIG_ESP32_WIFI_DYNAMIC_RX_BUFFER_NUM=32
CONFIG_ESP32_WIFI_STATIC_TX_BUFFER_NUM=0
CONFIG_ESP32_WIFI_DYNAMIC_TX_BUFFER_NUM=32
CONFIG_ESP32_WIFI_AMPDU_TX_ENABLED=y
CONFIG_ESP32_WIFI_TX_BA_WIN=6
CONFIG_ESP32_WIFI_AMPDU_RX_ENABLED=y
CONFIG_ESP32_WIFI_RX_BA_WIN=6

# HTTP Client - 保持不变
CONFIG_ESP_HTTP_CLIENT_ENABLE_HTTPS=n
CONFIG_HTTPD_MAX_REQ_HDR_LEN=1024

# Increase main task stack size - 保持不变
CONFIG_ESP_MAIN_TASK_STACK_SIZE=8192

# Enable JSON library - 保持不变
CONFIG_JSMN=y

# FreeRTOS - 保持不变
CONFIG_FREERTOS_HZ=1000

# Enable I2S driver - 保持不变
CONFIG_DRIVER_I2S_ENABLE=y

# Enable I2C driver - 保持不变
CONFIG_DRIVER_I2C_ENABLE=y

# Set log level - 保持不变
CONFIG_LOG_DEFAULT_LEVEL_INFO=y

# Memory optimization for large audio files
CONFIG_ESP_MAIN_TASK_STACK_SIZE=12288
CONFIG_ESP_SYSTEM_EVENT_TASK_STACK_SIZE=4096

# Enhanced heap configuration for PSRAM usage
CONFIG_HEAP_ABORT_WHEN_ALLOCATION_FAILS=n
CONFIG_HEAP_POISONING_DISABLED=y
```

## esp32_http_pcm_v5/sdkconfig.defaults
```kconfig
# ESP32S3 specific
CONFIG_IDF_TARGET="esp32s3"

# Flash Configuration - ESP32-S3-WROOM-1-N16R8 has 16MB Flash
CONFIG_ESPTOOLPY_FLASHSIZE_16MB=y
CONFIG_ESPTOOLPY_FLASHSIZE="16MB"
CONFIG_ESPTOOLPY_FLASHSIZE_DETECT=y

# PSRAM Configuration - 启用PSRAM支持
CONFIG_ESP32S3_SPIRAM_SUPPORT=y
CONFIG_SPIRAM=y
CONFIG_SPIRAM_MODE_OCT=y
CONFIG_SPIRAM_TYPE_AUTO=y
CONFIG_SPIRAM_SIZE=-1

# PSRAM 使用策略 - 允许通过heap_caps_malloc分配
CONFIG_SPIRAM_USE_CAPS_ALLOC=y
CONFIG_SPIRAM_MEMTEST=y

# PSRAM 速度配置 - 使用80MHz以保证稳定性
CONFIG_SPIRAM_SPEED_80M=y

# 允许BSS段在PSRAM中（可选，用于大型静态数组）
CONFIG_SPIRAM_ALLOW_BSS_SEG_EXTERNAL_MEMORY=n

# Cache配置
CONFIG_SPIRAM_CACHE_WORKAROUND=y

# Partition Table Configuration
# 使用自定义分区表以充分利用16MB Flash
CONFIG_PARTITION_TABLE_CUSTOM=y
CONFIG_PARTITION_TABLE_CUSTOM_FILENAME="partitions.csv"

# WiFi Configuration
CONFIG_ESP_WIFI_STATIC_RX_BUFFER_NUM=10
CONFIG_ESP_WIFI_DYNAMIC_RX_BUFFER_NUM=32
CONFIG_ESP_WIFI_STATIC_TX_BUFFER_NUM=0
CONFIG_ESP_WIFI_DYNAMIC_TX_BUFFER_NUM=32
CONFIG_ESP_WIFI_AMPDU_TX_ENABLED=y
CONFIG_ESP_WIFI_TX_BA_WIN=6
CONFIG_ESP_WIFI_AMPDU_RX_ENABLED=y
CONFIG_ESP_WIFI_RX_BA_WIN=6

# HTTP Client
CONFIG_ESP_HTTP_CLIENT_ENABLE_HTTPS=n
CONFIG_HTTPD_MAX_REQ_HDR_LEN=1024

# Increase main task stack size
CONFIG_ESP_MAIN_TASK_STACK_SIZE=8192

# Enable JSON library
CONFIG_JSMN=y

# FreeRTOS
CONFIG_FREERTOS_HZ=1000

# Enable I2S driver
CONFIG_DRIVER_I2S_ENABLE=y

# Enable I2C driver
CONFIG_DRIVER_I2C_ENABLE=y

# Set log level
CONFIG_LOG_DEFAULT_LEVEL_INFO=y
```
